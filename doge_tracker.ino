
#define double_buffer
#include <PxMatrix.h>

#ifdef ESP32
#gitignore ignore me

#define P_LAT 22
#define P_A 19
#define P_B 23
#define P_C 18
#define P_D 5
#define P_E 15
#define P_OE 2
hw_timer_t * timer = NULL;
portMUX_TYPE timerMux = portMUX_INITIALIZER_UNLOCKED;

#endif

#include <wifi_credentials.h>
#include <ESP8266WiFi.h>
#include <WiFiUdp.h>

#include <Ticker.h>
Ticker display_ticker;
#define P_LAT 16
#define P_A 5
#define P_B 4
#define P_C 15
#define P_D 12
#define P_E 0
#define P_OE 2

// Pins for LED MATRIX

int xspeed=2;

uint16_t static doge[]={0x0000, 0x0000, 0x0000, 0x0000, 0x0000, 0x0000, 0x0000, 0x0000, 0x0000, 0x0000, 0x0000, 0x0000, 0x0000, 0x0000, 0x0000, 0x0000,   // 0x0010 (16) pixels
0x0000, 0x0000, 0x0000, 0x0000, 0x0000, 0x0000, 0x0000, 0x0000, 0x0000, 0x0000, 0x0000, 0x0000, 0x0000, 0x0000, 0x0000, 0x0000,   // 0x0020 (32) pixels
0x0000, 0x0000, 0x0000, 0x0000, 0x0000, 0x0000, 0x0000, 0x0000, 0x0000, 0x0000, 0x0000, 0x0000, 0x0000, 0x0000, 0x0000, 0x0000,   // 0x0030 (48) pixels
0x0000, 0x0000, 0x0000, 0x0000, 0x0000, 0x0000, 0x0000, 0x0000, 0x0000, 0x0000, 0x0000, 0x0000, 0x0000, 0x0000, 0x0000, 0x0000,   // 0x0040 (64) pixels
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0x0000, 0x0000, 0x0000, 0x0000, 0x0000, 0x0000, 0x0000, 0x0000, 0x0000, 0x0000, 0x0000, 0x0000, 0x0000, 0x0000, 0x0000, 0x0000,   // 0x0380 (896) pixels
};// 0x0240 (576) pixels};
//PxMATRIX display(32,16,P_LAT, P_OE,P_A,P_B,P_C);
PxMATRIX display(64, 32, P_LAT, P_OE, P_A, P_B, P_C, P_D);
//PxMATRIX display(64,64,P_LAT, P_OE,P_A,P_B,P_C,P_D,P_E);
WiFiUDP Udp;
#ifdef ESP8266
// ISR for display refresh
void display_updater()
{
  display.display(70);
}
#endif

#ifdef ESP32
void IRAM_ATTR display_updater() {
  // Increment the counter and set the time of ISR
  portENTER_CRITICAL_ISR(&timerMux);
  display.display(70);
  portEXIT_CRITICAL_ISR(&timerMux);
}
#endif
String txt;
struct Text {
  char *text;
  uint16_t width, height;
  int16_t x, y;
  int16_t dx, dy;
} text = {"Hello", 0, 0, 0, 0, 1, 1};

char packetBuffer[UDP_TX_PACKET_MAX_SIZE + 1]; //buffer to hold incoming packet,

uint16_t textColor = display.color565(0, 0, 255);
uint16_t myBLACK = display.color565(0, 0, 0);
uint16_t lineColor = display.color565(255, 0, 0);
uint16_t backgroundColor = display.color565(0, 255, 0);
unsigned int localPort = 8888;      // local port to listen on
byte convertTwoBytes(char packetBuffer[]) {
  //take two Hex characters at the provided address and return the byte value
  //Must check that characters are valid hex before passing to this function
  byte temp = 0;
  if(packetBuffer[0]>='0' && packetBuffer[0]<='9') temp = packetBuffer[0] - '0';
  if(packetBuffer[0]>='A' && packetBuffer[0]<='F') temp = packetBuffer[0] - 'A' + 10;
  if(packetBuffer[0]>='a' && packetBuffer[0]<='f') temp = packetBuffer[0] - 'a' + 10;
  temp *= 0x10;
  if(packetBuffer[1]>='0' && packetBuffer[1]<='9') temp += packetBuffer[1] - '0';
  if(packetBuffer[1]>='A' && packetBuffer[1]<='F') temp += packetBuffer[1] - 'A' + 10;
  if(packetBuffer[1]>='a' && packetBuffer[1]<='f') temp += packetBuffer[1] - 'a' + 10;
  return temp;
}

bool convertRGB(char packetBuffer[], byte &R, byte &G, byte &B) {
  //return false if the provided array could not be converted, true if valid values put into R, G and B.
  if(packetBuffer[0] != '#') return false;
  if(strlen(packetBuffer) != 7) return false;
  for(byte i=1; i<7; i++) {
    //note this relies on certain properties of the ASCII characters: 0-9 occurs before A-Z occurs before a-z
    if(packetBuffer[i] < '0') return false;
    if(packetBuffer[i] > '9' && packetBuffer[i] < 'A') return false;
    if(packetBuffer[i] > 'F' && packetBuffer[i] < 'a') return false;
    if(packetBuffer[i] > 'f') return false;
  }
  R = convertTwoBytes(&packetBuffer[1]);
  G = convertTwoBytes(&packetBuffer[3]);
  B = convertTwoBytes(&packetBuffer[5]);
  return true;
}
void setup() {
  Serial.begin(115200);
  WiFi.mode(WIFI_STA);
  WiFi.begin(STASSID, STAPSK);
  while (WiFi.status() != WL_CONNECTED) {
    Serial.print('.');
    delay(500);
  }
  Serial.print("Connected! IP address: ");
  Serial.println(WiFi.localIP());
  Serial.printf("UDP server on port %d\n", localPort);
  Udp.begin(localPort);
    Serial.println(WiFi.localIP());

  display.begin(16);
  display.setMuxPattern(SHIFTREG_ABC_BIN_DE);
  //display.setScanPattern(WZAGZIG);
  
  display.flushDisplay();
  display.setTextWrap(true);
  //display.clearDisplay();
  Serial.print("Pixel draw latency in us: ");
  unsigned long start_timer = micros();
  display.drawPixel(1, 1, 0);
  unsigned long delta_timer = micros() - start_timer;
  Serial.println(delta_timer);

  //Serial.print("Display update latency in us: ");
  start_timer = micros();
  display.display(0);
  delta_timer = micros() - start_timer;
  //Serial.println(delta_timer);
  Serial.println("setup");

  display_ticker.attach(0.002, display_updater);
  yield();
  display.clearDisplay();
  //drawImage(0, 0);
  delay(500);



#ifdef ESP8266
  display_ticker.attach(0.004, display_updater);
#endif


  int16_t x1 = 0, y1 = 0;
  display.getTextBounds(text.text, 0, 0, &x1, &y1, &text.width, &text.height);
  text.width -= 2;
  text.height -= 2;
}

int16_t x = 0, dx = 1;

void drawImage2(int x, int y)
{
 int imageHeight = 30;
 int imageWidth = 30;
 int counter = 0;
 for (int yy = 0; yy < imageHeight; yy++)
 {
   for (int xx = 0; xx < imageWidth; xx++)
   {
     display.drawPixel(xx + x , yy + y, doge[counter]);
     counter++;
   }
 }
}
void loop() {
  //  display.clearDisplay();
  int packetSize = Udp.parsePacket();

  if (packetSize) {
    display.fillScreen(myBLACK);
    // read the packet into packetBufffer
    int r, g, b;
    int n = Udp.read(packetBuffer, UDP_TX_PACKET_MAX_SIZE);
    
    //if (packetSize <= 18) {
      int s = sscanf(packetBuffer, "%d %d %d", &r, &g, &b);
if (s==3){
      
    //}

  //uint16_t color=convertRGB(packetBuffer, r, g, b);
//Serial.println("r"+r);
//Serial.println("g"+g);
//Serial.println("b"+b);
    textColor =  display.color565(r, g, b);
}
else{
  
    packetBuffer[n] = 0;
    txt = packetBuffer;


    //  if(x+dx>=display.width() || x+dx<0)
    //    dx=-dx;
    //  x+=dx;
    //  display.drawLine(x,0, display.width()-x-1, display.height()-1, lineColor);

    //  if(text.x+text.dx+text.width>=display.width() || text.x+text.dx<0)
    //    text.dx=-text.dx;
    //  if(text.y+text.dy+text.height>=display.height() || text.y+text.dy<0)
    //    text.dy=-text.dy;
    //  text.x+=text.dx;
    //  text.y+=text.dy;    
    drawImage2(x, 6);
    drawImage2(x+30, 6);
    drawImage2(x-30, 6);
    drawImage2(x-60, 6);
    display.setTextColor(textColor);
    display.setCursor(text.x, text.y);
//    if(s!=3){
      display.print(txt);    
//    }


    display.showBuffer();
    x+=xspeed;
    if(x>=60){
      x=0;
    }
  }
  delay(20);
  }
  }
